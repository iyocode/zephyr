## drivers/gpio/Kconfig.pcal64xxa
```kconfig
# PCAL6408a GPIO configuration options

# Copyright (c) 2021 Nordic Semiconductor ASA
# Copyright (c) 2023 SILA Embedded Solutions GmbH
# SPDX-License-Identifier: Apache-2.0

menuconfig GPIO_PCAL64XXA
	bool "PCAL64XXA I2C GPIO chip"
	default y
	depends on DT_HAS_NXP_PCAL6408A_ENABLED || DT_HAS_NXP_PCAL6416A_ENABLED
	select I2C
	help
	  Enable driver for PCAL64XXA I2C GPIO chip.

config GPIO_PCAL64XXA_INIT_PRIORITY
	int "Init priority"
	default 70
	depends on GPIO_PCAL64XXA
	help
	  Device driver initialization priority.


config GPIO_PCAL6408A_DRIVE_STRENGTH_BYTES
	hex "PCAL6408A drive strength bytes"
	default 0xffff
	depends on GPIO_PCAL64XXA
	help
	  Set the drive strength for the PCAL6408A GPIO pins. The value is
	  a bitmask where each bit corresponds to a pin and affects DRIVE_STRENGTH0 and DRIVE_STRENGTH1. A bit set to 1
	  means that the pin will have a higher drive strength. The
	  default value is 0xffff, which means that all pins will have the
	  default drive strength.
```
